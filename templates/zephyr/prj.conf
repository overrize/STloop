## CMakeLists.txt
```
cmake_minimum_required(VERSION 3.20.0)

# Zephyr 项目配置
find_package(Zephyr REQUIRED HINTS $ENV{ZEPHYR_BASE})

project(stloop_zephyr_app)

target_sources(app PRIVATE src/main.c)
```

## prj.conf
```kconfig
# Zephyr Project Configuration
# STM32F411RE Nucleo Board

# Console
CONFIG_CONSOLE=y
CONFIG_UART_CONSOLE=y
CONFIG_SERIAL=y

# GPIO
CONFIG_GPIO=y

# Clock
CONFIG_SYS_CLOCK_HW_CYCLES_PER_SEC=100000000

# Kernel
CONFIG_MAIN_THREAD_PRIORITY=5
CONFIG_MAIN_STACK_SIZE=1024

# Debugging
CONFIG_DEBUG=y
CONFIG_ASSERT=y

# Power Management
CONFIG_PM=n

# Floating Point
CONFIG_FPU=y
CONFIG_FLOAT=y
```

## src/main.c
```c
/*
 * Zephyr RTOS Application
 * LED Blink Example for STM32F4
 */

#include <zephyr/kernel.h>
#include <zephyr/drivers/gpio.h>

/* 1000 msec = 1 sec */
#define SLEEP_TIME_MS   1000

/* LED on PA5 (Arduino D13 on Nucleo-F411RE) */
#define LED0_NODE DT_ALIAS(led0)

/*
 * A build error on this line means your board is unsupported.
 * See the sample documentation for information on how to fix this.
 */
static const struct gpio_dt_spec led = GPIO_DT_SPEC_GET(LED0_NODE, gpios);

void main(void)
{
    int ret;

    if (!gpio_is_ready_dt(&led)) {
        return;
    }

    ret = gpio_pin_configure_dt(&led, GPIO_OUTPUT_ACTIVE);
    if (ret < 0) {
        return;
    }

    while (1) {
        ret = gpio_pin_toggle_dt(&led);
        if (ret < 0) {
            return;
        }
        k_msleep(SLEEP_TIME_MS);
    }
}
```
